&spi1 {
  compatible = "nordic,nrf-spim";
  status = "okay";
  mosi-pin = <6>;
  // Unused pins, needed for SPI definition, but not used by the SK6812 driver itself.
  sck-pin = <12>;
  miso-pin = <22>;

  led_strip: SK6812@0 {
    compatible = "worldsemi,SK6812-spi";
    label = "SK6812";

    /* SPI */
    reg = <0>; /* ignored, but necessary for SPI bindings */
    spi-max-frequency = <4000000>;

    /* SK6812 */
    chain-length = <35>; /* number of LEDs */
    spi-one-frame = <0x70>;
    spi-zero-frame = <0x40>;
  };
};

/ {
    chosen {
        zmk,underglow = &led_strip;
    };
};
